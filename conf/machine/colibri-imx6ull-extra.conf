## conf/machine/colibri-imx6ull-extra.conf
```bitbake
# Our custom device tree name
DIAMOND_DEVICETREE_ROOT = "imx6ull-colibri-diamond-sic"
DIAMOND_DEVICETREE_SRC = "${DIAMOND_DEVICETREE_ROOT}.dts"
DIAMOND_DEVICETREE_BIN = "${DIAMOND_DEVICETREE_ROOT}.dtb"

KERNEL_DEVICETREE:append = "${KERNEL_DTB_PREFIX}${DIAMOND_DEVICETREE_BIN}"

# These are defined in layers/meta-toradex-nxp/conf/machine/include/colibri-imx6ull.inc
# Remove as we only ever want our one custom dtb built.
KERNEL_DEVICETREE:remove:colibri-imx6ull = " \
   ${KERNEL_DTB_PREFIX}imx6ull-colibri-aster.dtb \
   ${KERNEL_DTB_PREFIX}imx6ull-colibri-eval-v3.dtb \
   ${KERNEL_DTB_PREFIX}imx6ull-colibri-iris.dtb \
   ${KERNEL_DTB_PREFIX}imx6ull-colibri-iris-v2.dtb \
   ${KERNEL_DTB_PREFIX}imx6ull-colibri-wifi-aster.dtb \
   ${KERNEL_DTB_PREFIX}imx6ull-colibri-wifi-eval-v3.dtb \
   ${KERNEL_DTB_PREFIX}imx6ull-colibri-wifi-iris.dtb \
   ${KERNEL_DTB_PREFIX}imx6ull-colibri-wifi-iris-v2.dtb \
"
```
